## conf/layer.conf
```bitbake
# We have a conf and classes directory, add to BBPATH
BBPATH .= ":${LAYERDIR}"

# We have recipes-* directories, add to BBFILES
BBFILES += "${LAYERDIR}/recipes-*/*/*.bb \
            ${LAYERDIR}/recipes-*/*/*.bbappend"

BBFILE_COLLECTIONS += "meta-ecat"
BBFILE_PATTERN_meta-ecat = "^${LAYERDIR}/"
BBFILE_PRIORITY_meta-ecat = "6"

LAYERDEPENDS_meta-ecat = "core"
LAYERSERIES_COMPAT_meta-ecat = "scarthgap"
```
